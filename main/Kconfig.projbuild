## main/Kconfig.projbuild
```kconfig
# https://components.espressif.com/components/espressif/mdns/versions/1.3.2/examples/query_advertise
menu "mDNS Configuration"

    orsource "$IDF_PATH/examples/common_components/env_caps/$IDF_TARGET/Kconfig.env_caps"

    config MDNS_HOSTNAME
        string "mDNS Hostname"
        default "esp32-mdns"

    config MDNS_INSTANCE
        string "mDNS Instance Name"
        default "ESP32 with mDNS"

    config MDNS_PUBLISH_DELEGATE_HOST
        bool "Publish a delegated host"

    config MDNS_ADD_MAC_TO_HOSTNAME
        bool "Add mac suffix to hostname"
        default n

    config MDNS_ADD_CUSTOM_NETIF
        bool "Add user netif to mdns service"
        default n

endmenu
```
